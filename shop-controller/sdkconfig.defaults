## shop-controller/sdkconfig.defaults
```kconfig
# Target
CONFIG_IDF_TARGET="esp32c6"

# Flash size (8MB on DevKitC-1)
CONFIG_ESPTOOLPY_FLASHSIZE_8MB=y

# Partition table
CONFIG_PARTITION_TABLE_CUSTOM=y
CONFIG_PARTITION_TABLE_CUSTOM_FILENAME="partitions.csv"

# Zigbee coordinator/router mode
CONFIG_ZB_ENABLED=y
CONFIG_ZB_ZCZR=y

# WiFi
CONFIG_ESP_WIFI_SOFTAP_SUPPORT=n

# WiFi/Zigbee coexistence — prefer WiFi for stable MQTT
CONFIG_ESP_COEX_SW_COEXIST_ENABLE=y
CONFIG_ESP_COEX_EXTERNAL_COEXIST_ENABLE=n

# MQTT
CONFIG_MQTT_BUFFER_SIZE=1024

# Log level
CONFIG_LOG_DEFAULT_LEVEL_INFO=y

# Stack sizes for Zigbee
CONFIG_ESP_MAIN_TASK_STACK_SIZE=4096
```
